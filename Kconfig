## Kconfig
```kconfig
config ZMK_INPUT_PROCESSOR_SIGMOID_ACCEL
    bool "Enable sigmoid acceleration input processor"
    default y
    depends on ZMK_POINTING
    help
      Enable a custom input processor that applies Apple-style
      sigmoid acceleration to trackpad/mouse movement. Slow movements
      remain precise, fast movements are amplified.
```

## dts/bindings/input/zmk,input-processor-inertial.yaml
```yaml
description: |
  Inertial scrolling input processor for momentum/coasting effect.
  Cursor continues moving after finger lifts, with velocity decay.

  Example:
    &inertial {
        compatible = "zmk,input-processor-inertial";
        #input-processor-cells = <0>;
        decay-rate = <85>;        // 85% velocity retained per tick
        min-velocity = <50>;      // stop when velocity below this
        tick-ms = <16>;           // ~60fps updates
        lift-timeout-ms = <50>;   // detect finger lift after 50ms no input
    };

compatible: "zmk,input-processor-inertial"

include: base.yaml

properties:
  "#input-processor-cells":
    type: int
    required: true
    const: 0
    description: Must be zero - no parameters at binding time

  track-remainders:
    type: boolean
    description: Whether this processor tracks remainders internally.

  decay-rate:
    type: int
    default: 85
    description: |
      Percentage of velocity retained each tick (0-100).
      85 = smooth coast, 70 = quick stop, 95 = long glide.

  min-velocity:
    type: int
    default: 50
    description: |
      Stop coasting when velocity drops below this threshold.
      Higher = stops sooner, lower = coasts longer.

  tick-ms:
    type: int
    default: 16
    description: |
      Milliseconds between inertial update ticks.
      16 = ~60fps, 8 = ~120fps for smoother feel.

  lift-timeout-ms:
    type: int
    default: 50
    description: |
      Time without input before detecting finger lift and starting coast.
      Lower = more responsive, higher = less false triggers.
```

## dts/bindings/input/zmk,input-processor-sigmoid-accel.yaml
```yaml
description: |
  Sigmoid acceleration input processor for Steam Deck-style trackpad feel.
  Slow movements remain precise, fast movements are amplified.

  The acceleration curve follows: scale = min_scale + (max_scale - min_scale) * sigmoid((velocity - threshold) * steepness)

  Example:
    &sigmoid_accel {
        compatible = "zmk,input-processor-sigmoid-accel";
        #input-processor-cells = <0>;
        min-scale = <100>;      // 1.0x at slow speeds (divided by 100)
        max-scale = <300>;      // 3.0x at fast speeds (divided by 100)
        threshold = <50>;       // velocity threshold for acceleration
        steepness = <10>;       // how sharp the transition is (divided by 100)
    };

compatible: "zmk,input-processor-sigmoid-accel"

include: base.yaml

properties:
  "#input-processor-cells":
    type: int
    required: true
    const: 0
    description: Must be zero - no parameters at binding time

  min-scale:
    type: int
    default: 100
    description: |
      Minimum scale factor (at slow speeds), divided by 100.
      100 = 1.0x, 150 = 1.5x, etc.

  max-scale:
    type: int
    default: 300
    description: |
      Maximum scale factor (at fast speeds), divided by 100.
      200 = 2.0x, 300 = 3.0x, etc.

  threshold:
    type: int
    default: 50
    description: |
      Velocity threshold where acceleration curve is centered.
      Lower = acceleration kicks in earlier.

  steepness:
    type: int
    default: 10
    description: |
      Steepness of the sigmoid curve, divided by 100.
      Higher = sharper transition between slow/fast modes.
      10 = 0.1 (gradual), 50 = 0.5 (moderate), 100 = 1.0 (sharp)
```
